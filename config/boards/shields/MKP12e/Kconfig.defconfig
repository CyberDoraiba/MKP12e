## config/boards/shields/MKP12e/Kconfig.defconfig
```kconfig
# Copyright (c) 2022 The ZMK Contributors
# SPDX-License-Identifier: MIT

if SHIELD_MKP12E

config ZMK_KEYBOARD_NAME
    default "MKP12e"

endif
```

## config/boards/shields/MKP12e/Kconfig.shield
```kconfig
# Copyright (c) 2023 The ZMK Contributors
# SPDX-License-Identifier: MIT

config SHIELD_MKP12E
    def_bool $(shields_list_contains, MKP12e)
```

## config/west.yml
```yaml
manifest:
  remotes:
    - name: zmkfirmware
      url-base: https://github.com/zmkfirmware
  projects:
    - name: zmk
      remote: MKP12e
      revision: main
      import: app/west.yml
  self:
    path: config
```
